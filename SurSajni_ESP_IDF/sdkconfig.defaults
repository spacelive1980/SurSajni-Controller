## SurSajni_ESP_IDF/sdkconfig.defaults
```kconfig
# Sursajni Controller ESP-IDF Configuration Defaults

# Enable flash encryption support
CONFIG_SECURE_FLASH_ENCRYPTION_MODE_DEVELOPMENT=y
CONFIG_SECURE_FLASH_ENC_ENABLED=y
CONFIG_SECURE_FLASH_ENCRYPTION_MODE_RELEASE=n

# Partition table
CONFIG_PARTITION_TABLE_CUSTOM=y
CONFIG_PARTITION_TABLE_CUSTOM_FILENAME="partitions.csv"
CONFIG_PARTITION_TABLE_FILENAME="partitions.csv"

# WiFi Configuration
CONFIG_ESP32_WIFI_STATIC_RX_BUFFER_NUM=10
CONFIG_ESP32_WIFI_DYNAMIC_RX_BUFFER_NUM=32
CONFIG_ESP32_WIFI_DYNAMIC_TX_BUFFER_NUM=32

# LWIP (Networking)
CONFIG_LWIP_MAX_SOCKETS=16

# HTTP Server
CONFIG_HTTPD_MAX_REQ_HDR_LEN=1024
CONFIG_HTTPD_MAX_URI_LEN=512

# Watchdog timers
CONFIG_ESP_TASK_WDT_TIMEOUT_S=10

# FreeRTOS
CONFIG_FREERTOS_HZ=1000

# Log output
CONFIG_LOG_DEFAULT_LEVEL_INFO=y
CONFIG_LOG_MAXIMUM_LEVEL_VERBOSE=y

# Component config
CONFIG_ESPTOOLPY_FLASHSIZE_4MB=y
CONFIG_ESPTOOLPY_FLASHFREQ_80M=y
CONFIG_ESPTOOLPY_FLASHMODE_QIO=y

# Enable NVS encryption support
CONFIG_NVS_ENCRYPTION=y

# Security features (for production, enable these after testing)
# CONFIG_SECURE_BOOT_V2_ENABLED=y
# CONFIG_SECURE_BOOT_ALLOW_ROM_BASIC=n
# CONFIG_SECURE_DISABLE_ROM_DL_MODE=y
```

## sdkconfig.defaults
```kconfig
# Compiler options
CONFIG_COMPILER_CXX_EXCEPTIONS=y
CONFIG_COMPILER_CXX_RTTI=y

# ESP32 specific
CONFIG_ESP32_DEFAULT_CPU_FREQ_240=y
CONFIG_FREERTOS_HZ=1000

# Partition table
CONFIG_PARTITION_TABLE_CUSTOM=y
CONFIG_PARTITION_TABLE_CUSTOM_FILENAME="partitions.csv"
CONFIG_PARTITION_TABLE_FILENAME="partitions.csv"

# Flash size
CONFIG_ESPTOOLPY_FLASHSIZE_4MB=y

# WiFi
CONFIG_ESP32_WIFI_STATIC_RX_BUFFER_NUM=10
CONFIG_ESP32_WIFI_DYNAMIC_RX_BUFFER_NUM=32
CONFIG_ESP32_WIFI_DYNAMIC_TX_BUFFER_NUM=32
CONFIG_ESP_WIFI_SOFTAP_SUPPORT=y

# HTTP Server
CONFIG_HTTPD_MAX_REQ_HDR_LEN=1024
CONFIG_HTTPD_MAX_URI_LEN=512

# LWIP
CONFIG_LWIP_LOCAL_HOSTNAME="sursajni-controller"

# Main task stack size
CONFIG_ESP_MAIN_TASK_STACK_SIZE=8192

# WDT
CONFIG_ESP_TASK_WDT_TIMEOUT_S=50

# SPIRAM (if available)
# CONFIG_SPIRAM_SUPPORT=y
```
